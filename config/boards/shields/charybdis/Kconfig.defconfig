## config/boards/shields/charybdis/Kconfig.defconfig
```kconfig
if SHIELD_CHARYBDIS_RIGHT
config ZMK_KEYBOARD_NAME
    default "Charybdis"
config ZMK_SPLIT_BLE_ROLE_CENTRAL
    default y
endif

if SHIELD_CHARYBDIS_LEFT || SHIELD_CHARYBDIS_RIGHT
config ZMK_SPLIT
    default y
endif

# Minimal layer timing placeholders (refinement later)
config MOUSE_LAYER_INDEX
    int "Index of mouse layer"
    default 4

config SCROLL_LAYER_INDEX
    int "Index of scroll layer"
    default 5
```

## config/west.yml
```yaml
manifest:
  remotes:
    - name: zmk
      url-base: https://github.com/zmkfirmware
    - name: inorichi
      url-base: https://github.com/inorichi

  projects:
    - name: zmk
      remote: zmk
      revision: 4ec69cb7e658590adf6354027aca789b364a70c5 # pinned main (2025-10-30)
      import: app/west.yml
    - name: zmk-pmw3610-driver
      remote: inorichi
      revision: 1d9c2c68ca76012e1b1e5f6ef02fa5eadc4ca399 # pinned (2025-10-30)
      path: modules/pmw3610

  self:
    path: config
```
